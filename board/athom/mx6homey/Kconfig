## board/athom/mx6homey/Kconfig
```kconfig
if TARGET_MX6HOMEY

config SYS_BOARD
	default "mx6homey"

config SYS_VENDOR
	default "athom"

config SYS_CONFIG_NAME
	default "mx6homey"

endif
```

## configs/mx6homey_defconfig
```kconfig
CONFIG_ARM=y
CONFIG_ARCH_MX6=y
CONFIG_TARGET_MX6HOMEY=y

CONFIG_SPL=y
CONFIG_SPL_MMC_SUPPORT=y
CONFIG_SPL_EXT_SUPPORT=y
CONFIG_SPL_FAT_SUPPORT=y
CONFIG_SPL_SERIAL_SUPPORT=y
CONFIG_SPL_LIBDISK_SUPPORT=y
CONFIG_SPL_WATCHDOG_SUPPORT=y
CONFIG_SPL_GPIO_SUPPORT=y
CONFIG_SPL_LIBCOMMON_SUPPORT=y
CONFIG_SPL_LIBGENERIC_SUPPORT=y

CONFIG_DISTRO_DEFAULTS=y
CONFIG_SYS_EXTRA_OPTIONS="IMX_CONFIG=arch/arm/mach-imx/spl_sd.cfg,MX6QDL"
CONFIG_FAT_WRITE=y

CONFIG_BOARD_EARLY_INIT_F=y

CONFIG_CMD_GPIO=y
CONFIG_CMD_MMC=y
CONFIG_CMD_CACHE=y
CONFIG_CMD_EXT4_WRITE=y
CONFIG_CMD_FUSE=y
CONFIG_CMD_BLOB=y
CONFIG_CMD_UNZIP=y
CONFIG_CMD_IMLS=n

CONFIG_ENV_IS_NOWHERE=y
CONFIG_DM=y
CONFIG_DM_THERMAL=y
CONFIG_IMX_THERMAL=y

CONFIG_OF_LIBFDT=y
CONFIG_FIT=y
#CONFIG_FIT_SIGNATURE=y
CONFIG_SECURE_BOOT=y
CONFIG_RSA=y

CONFIG_BOOTDELAY=0
CONFIG_SYS_STDIO_DEREGISTER=y
```
